## Documentation/devicetree/bindings/clock/maxim,max9485.txt
```
Devicetree bindings for Maxim MAX9485 Programmable Audio Clock Generator

The driver for this device exposes 4 clocks in total:

- MAX9485_MCLKOUT: 	A gated, buffered output of the input clock of 27 MHz
- MAX9485_CLKOUT:	A PLL that can be configured to 16 different discrete
			frequencies
- MAX9485_CLKOUT[1,2]:	Two gated outputs for MAX9485_CLKOUT

MAX9485_CLKOUT[1,2] are children of MAX9485_CLKOUT which upchain all rate set
requests.

Required properties:
- compatible:	"maxim,max9485"
- clocks:	Input clock, must provice 27.000 MHz
- clock-names:	Must be set to "xclk"
- #clock-cells: From common clock binding; shall be set to 1

Optional properties:
- reset-gpio:		GPIO descriptor connected to the #RESET input pin
- vdd-supply:		A regulator node for Vdd
- clock-output-names:	Name of output clocks, as defined in common clock
			bindings

If not explicitly set, the output names are "mclkout", "clkout", "clkout1"
and "clkout2".

Clocks are defined as preprocessor macros in the dt-binding header.

Example:

	#include <dt-bindings/clock/maxim,max9485.h>

	xo_27mhz: xo_27mhz {
		compatible = "fixed-clock";
		#clock-cells = <0>;
		clock-frequency = <27000000>;
	};

	&i2c0 {
		max9485: max9485@63 {
			compatible = "maxim,max9485";
			clock-names = "xclk";
			clocks = <&xo_27mhz>;
			reg = <0x63>;
			reset-gpios = <&gpio 1 GPIO_ACTIVE_HIGH>;
			vdd-supply = <&3v3_reg>;
			#clock-cells = <1>;
		};
	};

	// Clock consumer node

	foo@0 {
		compatible = "bar,foo";
		/* ... */
		clock-names = "foo-intput-clk";
		clocks = <&max9485 MAX9485_CLKOUT1>;
	};
```

## Documentation/devicetree/bindings/sound/mrvl,pxa-ssp.txt
```
Marvell PXA SSP CPU DAI bindings

Required properties:

	compatible	Must be "mrvl,pxa-ssp-dai"
	port		A phandle reference to a PXA ssp upstream device

Example:

	/* upstream device */

	ssp1: ssp@41000000 {
		compatible = "mrvl,pxa3xx-ssp";
		reg = <0x41000000 0x40>;
		interrupts = <24>;
		clock-names = "pxa27x-ssp.0";
		dmas = <&pdma 13 3
			&pdma 14 3>;
		dma-names = "ssp1_rx", "ssp1_tx";
	};

	/* DAI as user */

	ssp_dai0: ssp_dai@0 {
		compatible = "mrvl,pxa-ssp-dai";
		port = <&ssp1>;
		#sound-dai-cells = <0>;
	};
```

## arch/arm/configs/mioa701_devicetree_defconfig
```kconfig
CONFIG_CROSS_COMPILE="arm-linux-gnueabi-"
# CONFIG_LOCALVERSION_AUTO is not set
CONFIG_DEFAULT_HOSTNAME="mioa701"
# CONFIG_SWAP is not set
CONFIG_SYSVIPC=y
CONFIG_POSIX_MQUEUE=y
# CONFIG_CROSS_MEMORY_ATTACH is not set
CONFIG_NO_HZ=y
CONFIG_IKCONFIG=y
CONFIG_IKCONFIG_PROC=y
CONFIG_LOG_BUF_SHIFT=16
CONFIG_BLK_DEV_INITRD=y
# CONFIG_UID16 is not set
CONFIG_SYSCTL_SYSCALL=y
# CONFIG_BASE_FULL is not set
# CONFIG_AIO is not set
CONFIG_EMBEDDED=y
# CONFIG_COMPAT_BRK is not set
CONFIG_SLAB=y
CONFIG_MODULES=y
CONFIG_MODULE_UNLOAD=y
CONFIG_MODULE_FORCE_UNLOAD=y
# CONFIG_LBDAF is not set
# CONFIG_BLK_DEV_BSG is not set
# CONFIG_IOSCHED_DEADLINE is not set
CONFIG_ARCH_PXA=y
CONFIG_MACH_PXA27X_DT=y
CONFIG_MACH_MIOA701=y
CONFIG_PREEMPT=y
CONFIG_AEABI=y
CONFIG_OABI_COMPAT=y
# CONFIG_COMPACTION is not set
CONFIG_CPU_FREQ=y
CONFIG_CPU_FREQ_DEFAULT_GOV_POWERSAVE=y
CONFIG_CPU_FREQ_GOV_PERFORMANCE=y
CONFIG_CPU_FREQ_GOV_CONSERVATIVE=y
CONFIG_FPE_FASTFPE=y
# CONFIG_CORE_DUMP_DEFAULT_ELF_HEADERS is not set
CONFIG_PM_AUTOSLEEP=y
CONFIG_NET=y
CONFIG_PACKET=y
CONFIG_UNIX=y
CONFIG_INET=y
CONFIG_IP_MULTICAST=y
# CONFIG_INET_XFRM_MODE_TRANSPORT is not set
# CONFIG_INET_XFRM_MODE_TUNNEL is not set
# CONFIG_INET_XFRM_MODE_BEET is not set
# CONFIG_INET_DIAG is not set
# CONFIG_IPV6 is not set
CONFIG_BT=y
CONFIG_BT_RFCOMM=y
CONFIG_BT_RFCOMM_TTY=y
CONFIG_BT_BNEP=y
CONFIG_BT_HCIUART=y
CONFIG_BT_HCIUART_LL=y
# CONFIG_WIRELESS is not set
# CONFIG_STANDALONE is not set
CONFIG_MTD=y
CONFIG_MTD_CMDLINE_PARTS=y
CONFIG_MTD_DOCG3=y
CONFIG_MTD_UBI=y
CONFIG_MTD_UBI_WL_THRESHOLD=256
CONFIG_BLK_DEV_LOOP=y
CONFIG_BLK_DEV_RAM=y
CONFIG_BLK_DEV_RAM_SIZE=16384
CONFIG_INPUT_EVDEV=y
# CONFIG_KEYBOARD_ATKBD is not set
CONFIG_KEYBOARD_GPIO=y
CONFIG_KEYBOARD_PXA27x=y
# CONFIG_INPUT_MOUSE is not set
CONFIG_INPUT_TOUCHSCREEN=y
CONFIG_TOUCHSCREEN_WM97XX=y
# CONFIG_TOUCHSCREEN_WM9705 is not set
# CONFIG_TOUCHSCREEN_WM9712 is not set
CONFIG_LEGACY_PTY_COUNT=0
CONFIG_SERIAL_NONSTANDARD=y
CONFIG_SERIAL_PXA=y
# CONFIG_HW_RANDOM is not set
CONFIG_I2C=y
CONFIG_I2C_CHARDEV=y
# CONFIG_I2C_HELPER_AUTO is not set
CONFIG_I2C_PXA=y
CONFIG_PDA_POWER=y
CONFIG_BATTERY_WM97XX=y
# CONFIG_HWMON is not set
CONFIG_WATCHDOG=y
CONFIG_WATCHDOG_CORE=y
CONFIG_SA1100_WATCHDOG=y
CONFIG_REGULATOR=y
CONFIG_REGULATOR_DEBUG=y
CONFIG_REGULATOR_FIXED_VOLTAGE=y
CONFIG_REGULATOR_MAX1586=y
CONFIG_MEDIA_SUPPORT=y
CONFIG_MEDIA_CAMERA_SUPPORT=y
CONFIG_VIDEO_ADV_DEBUG=y
CONFIG_V4L_PLATFORM_DRIVERS=y
CONFIG_SOC_CAMERA=y
CONFIG_VIDEO_PXA27x=y
# CONFIG_MEDIA_SUBDRV_AUTOSELECT is not set
CONFIG_SOC_CAMERA_MT9M111=y
# CONFIG_DVB_TUNER_DIB0090 is not set
CONFIG_FB=y
CONFIG_FB_PXA=y
CONFIG_FB_PXA_SMARTPANEL=y
CONFIG_BACKLIGHT_LCD_SUPPORT=y
CONFIG_LCD_CLASS_DEVICE=y
CONFIG_LCD_PLATFORM=y
CONFIG_BACKLIGHT_CLASS_DEVICE=y
# CONFIG_BACKLIGHT_GENERIC is not set
CONFIG_BACKLIGHT_PWM=y
CONFIG_FRAMEBUFFER_CONSOLE=y
CONFIG_FRAMEBUFFER_CONSOLE_ROTATION=y
CONFIG_SOUND=y
# CONFIG_SOUND_OSS_CORE_PRECLAIM is not set
CONFIG_SND=y
CONFIG_SND_SEQUENCER=y
CONFIG_SND_PCM_OSS=y
# CONFIG_SND_SUPPORT_OLD_API is not set
# CONFIG_SND_VERBOSE_PROCFS is not set
# CONFIG_SND_DRIVERS is not set
# CONFIG_SND_ARM is not set
CONFIG_SND_SOC=y
CONFIG_SND_PXA2XX_SOC=y
CONFIG_SND_PXA2XX_SOC_MIOA701=y
CONFIG_NOP_USB_XCEIV=y
CONFIG_USB_GADGET=y
CONFIG_USB_GADGET_DEBUG_FILES=y
CONFIG_USB_GADGET_DEBUG_FS=y
CONFIG_USB_GADGET_VBUS_DRAW=500
CONFIG_USB_PXA27X=y
CONFIG_USB_ETH=y
# CONFIG_USB_ETH_RNDIS is not set
CONFIG_MMC=y
# CONFIG_MMC_BLOCK_BOUNCE is not set
CONFIG_MMC_PXA=y
CONFIG_NEW_LEDS=y
CONFIG_LEDS_CLASS=y
CONFIG_LEDS_GPIO=y
CONFIG_RTC_CLASS=y
CONFIG_RTC_DRV_PXA=y
CONFIG_DMADEVICES=y
CONFIG_PXA_DMA=y
# CONFIG_IOMMU_SUPPORT is not set
CONFIG_PWM=y
CONFIG_PWM_PXA=y
CONFIG_EXT2_FS=y
CONFIG_EXT2_FS_XATTR=y
CONFIG_EXT2_FS_POSIX_ACL=y
CONFIG_EXT2_FS_SECURITY=y
# CONFIG_DNOTIFY is not set
CONFIG_MSDOS_FS=y
CONFIG_VFAT_FS=y
CONFIG_TMPFS=y
CONFIG_TMPFS_POSIX_ACL=y
CONFIG_UBIFS_FS=y
CONFIG_UBIFS_FS_ADVANCED_COMPR=y
CONFIG_MINIX_FS=y
CONFIG_PSTORE=y
CONFIG_PSTORE_CONSOLE=y
CONFIG_PSTORE_RAM=y
# CONFIG_NETWORK_FILESYSTEMS is not set
CONFIG_NLS_DEFAULT="cp437"
CONFIG_NLS_CODEPAGE_437=y
CONFIG_NLS_CODEPAGE_850=y
CONFIG_NLS_CODEPAGE_865=m
CONFIG_NLS_ASCII=y
CONFIG_NLS_ISO8859_1=y
CONFIG_NLS_UTF8=y
CONFIG_PRINTK_TIME=y
CONFIG_DYNAMIC_DEBUG=y
CONFIG_DEBUG_INFO=y
# CONFIG_ENABLE_MUST_CHECK is not set
CONFIG_READABLE_ASM=y
# CONFIG_DEBUG_PREEMPT is not set
CONFIG_FUNCTION_TRACER=y
CONFIG_IRQSOFF_TRACER=y
CONFIG_PREEMPT_TRACER=y
CONFIG_SCHED_TRACER=y
CONFIG_FTRACE_SYSCALLS=y
CONFIG_FUNCTION_PROFILER=y
CONFIG_ARM_PTDUMP=y
CONFIG_CRYPTO_CBC=y
CONFIG_CRYPTO_MD5=y
CONFIG_CRYPTO_SHA1=y
CONFIG_CRYPTO_DES=y
CONFIG_CRYPTO_ANSI_CPRNG=y
# CONFIG_CRYPTO_HW is not set
CONFIG_CRC_CCITT=y
CONFIG_CRC_T10DIF=y
CONFIG_LIBCRC32C=y
CONFIG_FONTS=y
CONFIG_FONT_8x8=y
CONFIG_FONT_MINI_4x6=y
```

## arch/arm/mach-pxa/Kconfig
```kconfig
if ARCH_PXA

menu "Intel PXA2xx Implementations"

config ARCH_LUBBOCK
	bool "Intel DBPXA250 Development Platform"
	select PXA25x
	select SA1111

config MACH_LOGICPD_PXA270
	bool "LogicPD PXA270 Card Engine Development Platform"
	select PXA27x

config MACH_MAINSTONE
	bool "Intel HCDDBBVA0 Development Platform"
	select PXA27x

config ARCH_PXA_IDP
	bool "Accelent Xscale IDP"
	select PXA25x

source "arch/arm/mach-pxa/eseries/Kconfig"
source "arch/arm/mach-pxa/asus620/Kconfig"
source "arch/arm/mach-pxa/asus716/Kconfig"
source "arch/arm/mach-pxa/asus730/Kconfig"
source "arch/arm/mach-pxa/h1900/Kconfig"
source "arch/arm/mach-pxa/h2200/Kconfig"
source "arch/arm/mach-pxa/h3900/Kconfig"
source "arch/arm/mach-pxa/h4000/Kconfig"
source "arch/arm/mach-pxa/hx4700/Kconfig"
source "arch/arm/mach-pxa/hx2750/Kconfig"
source "arch/arm/mach-pxa/h5400/Kconfig"
source "arch/arm/mach-pxa/htchimalaya/Kconfig"
source "arch/arm/mach-pxa/htcuniversal/Kconfig"
source "arch/arm/mach-pxa/htcalpine/Kconfig"
source "arch/arm/mach-pxa/magician/Kconfig"
source "arch/arm/mach-pxa/htcapache/Kconfig"
source "arch/arm/mach-pxa/htcblueangel/Kconfig"
source "arch/arm/mach-pxa/htcsable/Kconfig"
source "arch/arm/mach-pxa/htcathena/Kconfig"
source "arch/arm/mach-pxa/aximx3/Kconfig"
source "arch/arm/mach-pxa/aximx5/Kconfig"
source "arch/arm/mach-pxa/aximx30/Kconfig"
source "arch/arm/mach-pxa/aximx50/Kconfig"
source "arch/arm/mach-pxa/rover/Kconfig"
source "arch/arm/mach-pxa/palmld/Kconfig"
source "arch/arm/mach-pxa/palmt3/Kconfig"
source "arch/arm/mach-pxa/plat-recon/Kconfig"
source "arch/arm/mach-pxa/mioa701/Kconfig"

config MACH_GHI270HG
	bool "Grayhill Duramax HG"

config MACH_GHI270
	bool "Grayhill Duramax H"
	select PXA27x
	select MACH_GHI270HG

config MACH_LOOXC550
	bool "FSC LOOX C550"
	select PXA27x

config PXA_SHARPSL
	bool "SHARP Zaurus SL-5600, SL-C7xx and SL-Cxx00 Models"
	select SHARP_SCOOP
	select SHARP_PARAM
	help
	  Say Y here if you intend to run this kernel on a
	  Sharp Zaurus SL-5600 (Poodle), SL-C700 (Corgi),
	  SL-C750 (Shepherd), SL-C760 (Husky), SL-C1000 (Akita),
	  SL-C3000 (Spitz), SL-C3100 (Borzoi) or SL-C6000x (Tosa)
	  handheld computer.

config MACH_TRIZEPS4
	bool "Keith und Koep Trizeps4 DIMM-Module"
	select PXA27x

if PXA_SHARPSL

choice
	prompt "Select target Sharp Zaurus device range"

config PXA_SHARPSL_25x
	bool "Sharp PXA25x models (SL-5600, SL-C7xx and SL-C6000x)"
	select PXA25x

config PXA_SHARPSL_27x
	bool "Sharp PXA270 models (SL-Cxx00)"
	select PXA27x

endchoice

endif

if MACH_TRIZEPS4

choice
	prompt "Select base board for Trizeps 4 module"

config MACH_TRIZEPS4_CONXS
	bool "ConXS Eval Board"

config MACH_TRIZEPS4_ANY
	bool "another Board"

endchoice

endif

endmenu

config MACH_POODLE
	bool "Enable Sharp SL-5600 (Poodle) Support"
	depends on PXA_SHARPSL_25x
	select SHARP_LOCOMO
	select PXA_SSP

config MACH_CORGI
	bool "Enable Sharp SL-C700 (Corgi) Support"
	depends on PXA_SHARPSL_25x
	select PXA_SHARP_C7xx

config MACH_SHEPHERD
	bool "Enable Sharp SL-C750 (Shepherd) Support"
	depends on PXA_SHARPSL_25x
	select PXA_SHARP_C7xx

config MACH_HUSKY
	bool "Enable Sharp SL-C760 (Husky) Support"
	depends on PXA_SHARPSL_25x
	select PXA_SHARP_C7xx

config MACH_AKITA
	bool "Enable Sharp SL-1000 (Akita) Support"
	depends on PXA_SHARPSL_27x
	select PXA_SHARP_Cxx00
	select MACH_SPITZ
	select I2C
	select I2C_PXA

config MACH_SPITZ
	bool "Enable Sharp Zaurus SL-3000 (Spitz) Support"
	depends on PXA_SHARPSL_27x
	select PXA_SHARP_Cxx00

config MACH_BORZOI
	bool "Enable Sharp Zaurus SL-3100 (Borzoi) Support"
	depends on PXA_SHARPSL_27x
	select PXA_SHARP_Cxx00

config MACH_TOSA
	bool "Enable Sharp SL-6000x (Tosa) Support"
	depends on PXA_SHARPSL_25x

config PXA25x
	bool
	help
	  Select code specific to PXA21x/25x/26x variants

config PXA26x
	bool
	help
	  Select code specific to PXA26x variants

config PXA27x
	bool
	help
	  Select code specific to PXA27x variants

config PXA_SHARP_C7xx
	bool
	select PXA_SSP
	select SHARPSL_PM
	help
	  Enable support for all Sharp C7xx models

config PXA_SHARP_Cxx00
	bool
	select PXA_SSP
	select SHARPSL_PM
	help
	  Enable common support for Sharp Cxx00 models

config PXA_SSP
	tristate
	help
	  Enable support for PXA2xx SSP ports

config PXA_SUSPEND_SAVE_EXTRA_REGS
	bool
	help
	  Save additional registers on the stack during suspend
	  to work around certain bootloaders overwriting them
	  during resume.

config PXA27x_VOLTAGE
	tristate "Support PXA27x CPU Core Voltage Change Sequencer"
	depends PXA27x && CPU_FREQ_PXA

config PXA27x_VOLTAGE_MAX158xx
	tristate "MAX158xx PMIC"
	depends on PXA27x_VOLTAGE

config GPIO
 bool "GPIO pin support for PXA27x"
 default y if ARM || PPC
 default n
 help
 Enabling this option adds support for PXA GPIO pins. Most
 System-on-Chip processors have this kind of pins mostly shared
 with some kind of internal hardware. Remaining pins may be used
 for any purposes (input/output/interrupt etc). To do so, enable
 this feature and provide some kernel parameters to define what
 pins are available. To define one or more GPIO pin give a:
 gpio.mapping=<pin#>:(in|(out:(hi|lo)))[.<pin#>:(in|(out:(hi|lo)))]
 Where <pin#> is any GPIO pin number your SoC supports, out or in
 is the data direction and hi or lo is one of the possible
 levels an output pin can have.
 For example. You have three GPIO: pin 8, 63 and 113. Pin 8 is a
 simple key input, pin 63 an output to control a motor. It needs
 a high level first to stop the motor while booting. Pin 113 is
 also an output pin, but needs low level while booting. To do so,
 give this kernel parameter:
 gpio.mapping=8:in.63:out:hi.113:out:lo
 With "cat /proc/gpio" you will get:
 GPIO POLICY DIRECTION OWNER
 8: user space input kernel
 63: user space output kernel
 113: user space output kernel
 To set pin 63 to low (to start the motor) do a:
 $ echo 0 > /sys/class/gpio/gpio63/level
 Or to stop the motor again:
 $ echo 1 > /sys/class/gpio/gpio63/level
 To get the level of the key (pin 8) do:
 $ cat /sys/class/gpio/gpio8/level
 The result will be 1 or 0.

 To add new GPIO pins at runtime (lets say pin 88 should be an input)
 you can do a:
 $ echo 88:in > /sys/class/gpio/map_gpio
 The same with a new GPIO pin 95, it should be an output and at high level:
 $ echo 95:out:hi > /sys/class/gpio/map_gpio

 After that "cat /proc/gpio" will show you:
 GPIO POLICY DIRECTION OWNER
 8: user space input kernel
 63: user space output kernel
 113: user space output kernel
 88: user space input kernel
 95: user space output kernel

 Note: You can add more than one new GPIO pin in one step. The period is the
 delimiter between each pin definition. To add the pins 88 and 95 in the
 example above in one step do a:
 $ echo 88:in.95:out:hi > /sys/class/gpio/map_gpio

 To remove any of these GPIOs use (in this example GPIO pin 95):
 $ echo 95 > /sys/class/gpio/unmap_gpio

 If unsure, say N.



endif
```

## arch/arm/mach-pxa/htcathena/Kconfig
```kconfig
menuconfig MACH_HTCATHENA
	bool "HTC Athena"
	select PXA27x
	select PXA_SSP
	select BOARD_IRQ_MAP_BIG
	select HTC_EGPIO
        select PXA_SSP
        select ADC
	help
		Say Y here if you intend to run this kernel on a
		HTC Athena. Currently there is only basic support
		for this phone.

#config HTCATHENA_PHONE
#	tristate "HTC Alpine Phone driver"
#	depends on MACH_HTCATHENA
#	help
#	  Experimental driver for the Athena's MSM6275 UMTS chipset.

config HTCATHENA_VSFB
	tristate "HTC Athena VSFB LCD support"
	depends on MACH_HTCATHENA && LCD_CLASS_DEVICE
	help
	  This driver provides primitive support for HTC Athena LCD display.

config HTCATHENA_BLUETOOTH
	tristate "HTC Athena Bluetooth"
	depends on MACH_HTCATHENA && HTC_EGPIO
	help
	  Enables support for the TI BRF6150 Bluetooth Module
	  in HTC Athena.

config HTCATHENA_GPS
	tristate "HTC Athena GPS"
	depends on MACH_HTCATHENA && HTC_EGPIO
	help
	  Enables support for the SiRF-3 GPS Module
	  in HTC Athena.
```
