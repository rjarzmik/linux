## arch/arm/mach-pxa/htcsable/Kconfig
```kconfig
menu HTC_HW6X00

config MACH_HTCBEETLES
	bool "HTC Beetles (hPaq hw65xx)"
	select PXA27x
	select BOARD_IRQ_MAP_BIG
	select KEYBOARD_GPIO
	select KEYBOARD_PXA27x
	help
		HTC Beetles (iPAQ hw651x) support.

config MACH_HW6900
	bool "HTC Sable (hPaq hw69xx)"
	select PXA27x
	select BOARD_IRQ_MAP_BIG
	select KEYBOARD_GPIO
	select KEYBOARD_PXA27x
	help
		HTC Sable (iPAQ hw691x) support.

config HTCSABLE_LCD
	tristate "HTC Beetles/Sable LCD"
	depends on ( MACH_HW6900 || MACH_HTCBEETLES ) && HTC_ASIC3 && LCD_CLASS_DEVICE
	help
		This driver provides support for changing power and brightness
		on HTC Sable LCD display.


config HTCSABLE_BACKLIGHT
	bool "HTC Beetles/Sable Backlight"
	depends on ( MACH_HW6900 || MACH_HTCBEETLES ) && HTC_ASIC3 && BACKLIGHT_CLASS_DEVICE
	help
		This driver provides support for changing power and brightness
		on HTC Sable LCD backlight.

config HTCSABLE_ROM
	bool "HTC Beetles/Sable ROM"
	depends on ( MACH_HW6900 || MACH_HTCBEETLES ) && HTC_ASIC3 && MTD
	help
		This driver provides access to devices' ROM
		(where IPL bootloader) is stored.

config HTCSABLE_BT
	bool "HTC Beetles/Sable Bluetooth"
	depends on ( MACH_HW6900 || MACH_HTCBEETLES ) && HTC_ASIC3 && BT
	help
		This driver provides support for Bluetooth module.

config HTCSABLE_PHONE
	bool "HTC Beetles/Sable Phone"
	depends on ( MACH_HW6900 || MACH_HTCBEETLES ) && HTC_ASIC3
	help
		This driver provides support for Phone module.

endmenu
```

## arch/arm/mach-pxa/mioa701/Kconfig
```kconfig
menuconfig MACH_MIOA701
	bool "MIO A701"
	select PXA27x
	select IWMMXT
	select BOARD_IRQ_MAP_SMALL
	help
		Say Y here if you intend to run this kernel on a
		MIO A701. Currently there is only basic support
		for this PDA.

config MACH_MIOA701_SOUND
	tristate "MIO A701 sound support"
	depends on MACH_MIOA701
	select SND_PXA2XX_SOC_MIOA701
	help
	  Enable support for the sound chip of the MIO A701.

config MIOA701_BLUETOOTH
	tristate "MITAC MIO A701 Bluetooth"
	depends on MACH_MIOA701
	help
	  Enables support for the TI BRF6150 Bluetooth Module
	  in the MIO A701.

config MIOA701_GSM
	tristate "MITAC MIO A701 GSM"
	depends on MACH_MIOA701
	help
	  Enables support for the Sagem XS200 GSM Module
	  in the MIO A701.

config MIOA701_GPS
	tristate "MITAC MIO A701 GPS"
	depends on MACH_MIOA701
	help
	  Enables support for the GPS Module
	  in the MIO A701.

config MIOA701_PM
	bool "MITAC MIO A701 PM"
	depends on MACH_MIOA701 && PM
	help
	  Enables support for the Power Managment
	  in the MIO A701 (suspend/resume)

config MIOA701_BATTERY
	tristate "MITAC MIO A701 Battery"
	depends on MACH_MIOA701 && PM && TOUCHSCREEN_WM97XX
	help
	  Enables support for the Mio A701 battery

config MIOA701_LEDS
	tristate "MITAC MIO A701 LEDS"
	depends on MACH_MIOA701
	help
	  Enables support for the Leds and Vibrator
	  in the MIO A701.

config MIOA701_UDC
        bool "USB Device Controller support"
        depends on MACH_MIOA701 && USB_PXA27X
        help
          Enables MIO A701 specific USB detection
```

## arch/arm/mach-pxa/palmld/Kconfig
```kconfig
menuconfig MACH_XSCALE_PALMLD
	bool "Palm LifeDrive"
	select PXA27x
	help
		Say Y here if you intend to run this kernel on a
		Palm LifeDrive. Currently there is only basic support
		for this PDA.
```

## arch/arm/mach-pxa/palmt3/Kconfig
```kconfig
menuconfig MACH_T3XSCALE
	bool "Palm Tungsten T3"
	select PXA25x
	help
	  This enables support for Palm Tungsten T3 handheld.
```
